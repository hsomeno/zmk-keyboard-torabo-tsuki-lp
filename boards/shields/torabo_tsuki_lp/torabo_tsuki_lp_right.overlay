#include "torabo_tsuki_lp.dtsi"
#include <input/processors.dtsi>
#include <dt-bindings/zmk/input_transform.h>

&pointing_listener {
    /* statusを明示的にokayにする（念のため） */
    status = "okay";
    
    input-processors = <
        /* 1. 軸の反転 */
        &zip_xy_transform (INPUT_TRANSFORM_X_INVERT | INPUT_TRANSFORM_Y_INVERT)
        
        /* 2. 移動速度の倍率設定（お好みで 1 3 などに調整してください） */
        &zip_xy_scaler 1 2
        
        /* 3. 【追加】移動をスクロールに変換する判定を入れる */
        &zip_xy_to_scroll_mapper
    >;
};
&size_s_transform {
    col-offset = <7>;
};

&size_m_transform {
    col-offset = <7>;
};

&size_l_transform {
    col-offset = <7>;
};